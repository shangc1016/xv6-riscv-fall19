/* 指定输出文件的架构应为 RISC-V */
OUTPUT_ARCH( "riscv" )
/* 指定程序的入口点是符号 _entry */
ENTRY( _entry )

/* 定义输出文件的内存布局 */
SECTIONS
{
  /*
   * ensure that entry.S / _entry is at 0x80000000,
   * where qemu's -kernel jumps.
   */
  /* 将当前地址设置为 0x80000000。这通常是 RISC-V 二进制文件在加载到内存时的起始地址 */
  . = 0x80000000;
  /* 这个部分包含程序的代码 */
  .text :
  {
    /* 包含所有输入文件中命名为 ".text" 的部分 */
    *(.text)
    /* 将当前地址对齐到 0x1000 边界 */
    . = ALIGN(0x1000);
    /* 包含所有输入文件中命名为 "trampsec" 的部分 */
    *(trampsec)
  }

  /* 将当前地址对齐到 0x1000 边界 */
  . = ALIGN(0x1000);
  /* 用当前地址的值定义符号 etext。这通常用于标记文本（代码）部分的结束 */
  PROVIDE(etext = .);

  /*
   * make sure end is after data and bss.
   */
   /* 这个部分包含已初始化的数据 */
  .data : {
    /* 包含所有输入文件中命名为 ".data" 的部分 */
    *(.data)
  }
  /* 这个部分包含未初始化的数据 */
  .bss : {
    /* 包含所有输入文件中命名为 ".bss" 的部分 */
    *(.bss)
    /* 包含所有以 ".sbss" 开头的部分 */
    *(.sbss*)
    /* 用当前地址的值定义符号 end。这通常用于标记数据和bss部分的结束 */
     PROVIDE(end = .);
  }
}

/* 
在链接脚本中，.sbss 通常是用于存放未初始化的静态变量（未初始化的静态数据段）的段名。
这些变量会在程序执行之前由系统清零。
这与 .bss 段类似，不同之处在于 .sbss 通常用于存放在启动代码中定义的静态变量
而 .bss 通常用于存放在用户代码中定义的静态变量。

 */
